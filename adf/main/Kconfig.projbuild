## adf/main/Kconfig.projbuild
```kconfig
menu "Radio Firmware Configuration"
  config RADIO_WIFI_SSID
    string "Default WiFi SSID"
  config RADIO_WIFI_PASSWORD
    string "Default WiFi Password"
endmenu
```

## adf/sdkconfig.defaults
```kconfig
# Configure our hardware
CONFIG_IDF_TARGET="esp32s3"
CONFIG_ESP_DEFAULT_CPU_FREQ_MHZ_240=y
CONFIG_ESPTOOLPY_FLASHSIZE_4MB=y
CONFIG_SPIRAM=y

# Firmware size optimizations
CONFIG_COMPILER_OPTIMIZATION_SIZE=y
CONFIG_ETH_USE_SPI_ETHERNET=n
CONFIG_ESP_WIFI_ENTERPRISE_SUPPORT=n
CONFIG_MQTT_TRANSPORT_WEBSOCKET=n
CONFIG_USE_AFE=n
CONFIG_USE_WAKENET=n
CONFIG_USE_MULTINET=n

# Disable codecs we're not using
CONFIG_CODEC_ES8311_SUPPORT=n
CONFIG_CODEC_ES7210_SUPPORT=n
CONFIG_CODEC_ES7243_SUPPORT=n
CONFIG_CODEC_ES7243E_SUPPORT=n
CONFIG_CODEC_ES8156_SUPPORT=n
CONFIG_CODEC_AW88298_SUPPORT=n
CONFIG_CODEC_ES8374_SUPPORT=n
CONFIG_CODEC_ES8388_SUPPORT=n
CONFIG_CODEC_TAS5805M_SUPPORT=n
CONFIG_AUDIO_BOARD_CUSTOM=y

# Configure functionality that we need
CONFIG_FREERTOS_ENABLE_BACKWARD_COMPATIBILITY=y
CONFIG_FREERTOS_USE_TRACE_FACILITY=y
CONFIG_FREERTOS_USE_STATS_FORMATTING_FUNCTIONS=y
CONFIG_FREERTOS_VTASKLIST_INCLUDE_COREID=y
CONFIG_ULP_COPROC_ENABLED=y
CONFIG_ESP_CONSOLE_USB_SERIAL_JTAG=y
CONFIG_ESP_CONSOLE_SECONDARY_NONE=y
CONFIG_ESP_COREDUMP_ENABLE_TO_FLASH=y
CONFIG_BOOTLOADER_APP_ROLLBACK_ENABLE=y
CONFIG_MBEDTLS_SSL_PROTO_DTLS=y
CONFIG_PTHREAD_DEFAULT_CORE_1=y
CONFIG_MBEDTLS_EXTERNAL_MEM_ALLOC=y
CONFIG_SPIRAM_MALLOC_ALWAYSINTERNAL=1024
CONFIG_SPIRAM_TRY_ALLOCATE_WIFI_LWIP=y
CONFIG_SPIRAM_ALLOW_BSS_SEG_EXTERNAL_MEMORY=y
CONFIG_LWIP_STATS=y

# Only trust LetsEncrypt's root cert
CONFIG_MBEDTLS_CERTIFICATE_BUNDLE_DEFAULT_NONE=y
CONFIG_MBEDTLS_CUSTOM_CERTIFICATE_BUNDLE=y
CONFIG_MBEDTLS_CUSTOM_CERTIFICATE_BUNDLE_PATH="certificates.pem"

CONFIG_PARTITION_TABLE_CUSTOM=y
CONFIG_PARTITION_TABLE_CUSTOM_FILENAME="partitions.csv"
```

## components/kvswebrtcclient/Kconfig
```kconfig
config KVSWEBRTC_LOG_STREAMING
    bool "Enable streaming logs from kvswebrtc."
    depends on LOG_DEFAULT_LEVEL_VERBOSE
    help
        This enables streaming logs (at log level "verbose") in kvswebrtc.
```

## main/Kconfig.projbuild
```kconfig
menu "Hunt"
config RADIO_GIANT_SWITCH
    bool "Enable giant-switch"
    default 0
endmenu
```

## sdkconfig.defaults
```kconfig
# Configure our hardware
CONFIG_IDF_TARGET="esp32s3"
CONFIG_ESP_DEFAULT_CPU_FREQ_MHZ_240=y
CONFIG_ESPTOOLPY_FLASHSIZE_4MB=y
CONFIG_SPIRAM=y

# Firmware size optimizations
CONFIG_COMPILER_OPTIMIZATION_SIZE=y
CONFIG_ETH_USE_SPI_ETHERNET=n
CONFIG_ESP_WIFI_ENTERPRISE_SUPPORT=n
CONFIG_MQTT_TRANSPORT_WEBSOCKET=n
CONFIG_USE_AFE=n
CONFIG_USE_WAKENET=n
CONFIG_USE_MULTINET=n
CONFIG_ESP_ERR_TO_NAME_LOOKUP=n
CONFIG_MBEDTLS_ERROR_STRINGS=n
CONFIG_BT_NIMBLE_MAX_CONNECTIONS=1

# Performance optimizations
CONFIG_ESP_WIFI_DYNAMIC_RX_BUFFER_NUM=64
CONFIG_ESP_WIFI_RX_BA_WIN=32
CONFIG_LWIP_DHCP_RESTORE_LAST_IP=y
CONFIG_LWIP_UDP_RECVMBOX_SIZE=16

# Disable codecs we're not using
CONFIG_CODEC_ES8311_SUPPORT=n
CONFIG_CODEC_ES7210_SUPPORT=n
CONFIG_CODEC_ES7243_SUPPORT=n
CONFIG_CODEC_ES7243E_SUPPORT=n
CONFIG_CODEC_ES8156_SUPPORT=n
CONFIG_CODEC_AW88298_SUPPORT=n
CONFIG_CODEC_ES8374_SUPPORT=n
CONFIG_CODEC_ES8388_SUPPORT=n
CONFIG_CODEC_TAS5805M_SUPPORT=n
CONFIG_AUDIO_BOARD_CUSTOM=y

# Configure functionality that we need
CONFIG_FREERTOS_ENABLE_BACKWARD_COMPATIBILITY=y
CONFIG_FREERTOS_USE_TRACE_FACILITY=y
CONFIG_FREERTOS_USE_STATS_FORMATTING_FUNCTIONS=y
CONFIG_FREERTOS_VTASKLIST_INCLUDE_COREID=y
CONFIG_FREERTOS_GENERATE_RUN_TIME_STATS=y
CONFIG_FREERTOS_RUN_TIME_COUNTER_TYPE_U64=y
CONFIG_FREERTOS_TASK_NOTIFICATION_ARRAY_ENTRIES=2
CONFIG_ESP_MAIN_TASK_AFFINITY_CPU1=y
CONFIG_ESP_CONSOLE_USB_SERIAL_JTAG=y
CONFIG_ESP_CONSOLE_SECONDARY_NONE=y
CONFIG_ESP_COREDUMP_ENABLE_TO_FLASH=y
CONFIG_ESP_COREDUMP_CHECK_BOOT=n
CONFIG_ESP_SYSTEM_PANIC_REBOOT_DELAY_SECONDS=5
CONFIG_BOOTLOADER_APP_ROLLBACK_ENABLE=y
CONFIG_MBEDTLS_SSL_PROTO_DTLS=y
CONFIG_MBEDTLS_EXTERNAL_MEM_ALLOC=y
CONFIG_MBEDTLS_SSL_DTLS_SRTP=y
CONFIG_SPIRAM_MALLOC_ALWAYSINTERNAL=1024
CONFIG_SPIRAM_TRY_ALLOCATE_WIFI_LWIP=y
CONFIG_SPIRAM_ALLOW_BSS_SEG_EXTERNAL_MEMORY=y
CONFIG_LWIP_STATS=y
CONFIG_LOG_TIMESTAMP_SOURCE_SYSTEM=y
CONFIG_LOG_DEFAULT_LEVEL_WARN=y
CONFIG_LOG_MAXIMUM_LEVEL_DEBUG=y
CONFIG_LOG_MASTER_LEVEL=y
CONFIG_BOOTLOADER_LOG_LEVEL_WARN=y
CONFIG_PTHREAD_TASK_STACK_SIZE_DEFAULT=8192
CONFIG_LITTLEFS_SDMMC_SUPPORT=y
CONFIG_THINGSBOARD_ENABLE_DYNAMIC=y
CONFIG_ESP_WIFI_11KV_SUPPORT=y
CONFIG_ESP_WIFI_11R_SUPPORT=y
CONFIG_BT_ENABLED=y
CONFIG_BT_NIMBLE_ENABLED=y
CONFIG_BT_NIMBLE_MEM_ALLOC_MODE_EXTERNAL=y
CONFIG_BT_NIMBLE_50_FEATURE_SUPPORT=n

CONFIG_PARTITION_TABLE_CUSTOM=y
CONFIG_PARTITION_TABLE_CUSTOM_FILENAME="partitions.csv"
```
